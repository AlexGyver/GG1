/*
Created 2016
by AlexGyver
AlexGyver Home Labs Inc.
*/

#include <Servo.h>   //используем библиотеку для работы с сервоприводом
Servo servo;     //объявляем переменную servo типа Servo

byte flag=0; //флажок для запоминания положения кнопки
byte trigger=0; //положение спусковой кнопки
byte set=0; //положение смены типа стрельбы  авто(1) / одиночные (0)
int del=20;  //задержка клапана, миллисекунды
int startpos=145; //заднее положение сервы (затвор открыт)
int stoppos=51;  //переднее положение сервы (затвор закрыт)

void setup()    
{       
	pinMode(2, OUTPUT);   //клапан на 2 порту
	pinMode(3, INPUT);  //спусковая кнопка на 3 порту
	servo.attach(4);  //серво на 4 порту  
	pinMode(5, INPUT);  //переключатель 5 порт
	servo.write(stoppos);  //поставить серву в переднее положение
} 

void shot() {
	digitalWrite(2,HIGH);  //открыть клапан
	delay(del);       //подождать время, равное del 
	digitalWrite(2,LOW);  //закрыть клапан
	delay(20);  //подождать немного, чтобы воздух вышел из ствола
	servo.write(startpos);  //открыть затвор
	delay(272);       //подождать серву (шарик попадает на магнит)
	servo.write(stoppos);   //закрыть затвор
	delay(272);       //столько же подождать серву (шарик попадает в ствол)
}

void loop() { 
	set=digitalRead(5); //считываем положение переключателя
	trigger=digitalRead(3);  //считываем положение спусковой кнопки
	
	if(trigger==1&&set==0&&flag==0) { //если спусковая кнопка нажата, выбран режим стрельбы ОДИНОЧНЫМИ и флаг=0
		shot();
		flag=1;         //поставить флажок, что кнопка нажата
	} 

	if(trigger==0&&set==0&&flag==1) { //если кнопка отжата, выбран режим стрельбы ОДИНОЧНЫМИ и флаг=1            
		flag=0;    //ставим флажок, что кнопка больше не нажата
	}
	
	if(trigger==1&&set==1&&flag==0) { //если спусковая кнопка нажата, выбран АВТОМАТИЧЕСКИЙ режим стрельбы и флаг=0
		shot();
	} 
	
	delay(5);   //задержка для стабильности работы прошивки
} 


